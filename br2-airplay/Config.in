## br2-airplay/package/airplay-web/Config.in
```kconfig
config BR2_PACKAGE_AIRPLAY_WEB
	bool "airplay-web"
	depends on BR2_PACKAGE_HOST_RUSTC_TARGET_ARCH_SUPPORTS
	select BR2_PACKAGE_HOST_RUSTC
	help
	  Read-only web interface (port 80): status of the AirPlay
	  speaker (audio, network, system, services, storage, log).
	  Rust server with no external dependencies; sources in
	  src/airplay-web of the BR2_EXTERNAL tree.
```
